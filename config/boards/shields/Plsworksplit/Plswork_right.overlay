#include "Plswork.dtsi"

&default_transform { // Offset of 7 because the left side has 7 columns
    col-offset = <7>;
};

&kscan0 {
    col-gpios = <&pro_micro 10 (GPIO_ACTIVE_HIGH)>,
                <&pro_micro 16 (GPIO_ACTIVE_HIGH)>,
                <&pro_micro 14 (GPIO_ACTIVE_HIGH)>,
                <&pro_micro 15 (GPIO_ACTIVE_HIGH)>,
                <&pro_micro 7 (GPIO_ACTIVE_HIGH)>,
                <&pro_micro 8 (GPIO_ACTIVE_HIGH)>,
                <&pro_micro 9 (GPIO_ACTIVE_HIGH)>;
};